## CMakeLists.txt
```
#
# Copyright (c) 2021 Nordic Semiconductor
#
# SPDX-License-Identifier: LicenseRef-Nordic-5-Clause
#

cmake_minimum_required(VERSION 3.13.1)

find_package(Zephyr REQUIRED HINTS $ENV{ZEPHYR_BASE})
project(debug_module_test)

# Set CMake path variables for convenience
set(MEMFAULT_SDK_DIR ${ZEPHYR_BASE}/../modules/lib/memfault-firmware-sdk)
set(NRF_SDK_DIR ${ZEPHYR_BASE}/../nrf)
set(ASSET_TRACKER_V2_DIR ../..)

# Generate runner for the test
test_runner_generate(src/debug_module_test.c)

# Create mock for Memfault SDK source files
cmock_handle(${MEMFAULT_SDK_DIR}/components/include/memfault/metrics/metrics.h memfault/metrics)
cmock_handle(${MEMFAULT_SDK_DIR}/ports/zephyr/include/memfault/ports/zephyr/http.h memfault/ports/zephyr)
cmock_handle(${MEMFAULT_SDK_DIR}/components/include/memfault/core/data_packetizer.h memfault/core)
cmock_handle(${MEMFAULT_SDK_DIR}/components/include/memfault/core/trace_event.h memfault/core)
cmock_handle(${MEMFAULT_SDK_DIR}/ports/include/memfault/ports/watchdog.h memfault/ports)

# Create mock for nRF SDK
cmock_handle(${NRF_SDK_DIR}/include/event_manager.h)
cmock_handle(${NRF_SDK_DIR}/subsys/event_manager/event_manager_priv.h )

# Create mock for Asset Tracker v2 application source files
cmock_handle(${ASSET_TRACKER_V2_DIR}/src/modules/modules_common.h)
cmock_handle(${ASSET_TRACKER_V2_DIR}/src/watchdog/watchdog_app.h)

# Add debug module (Unit Under Test)
target_sources(app PRIVATE ${ASSET_TRACKER_V2_DIR}/src/modules/debug_module.c)

# Add test source file
target_sources(app PRIVATE src/debug_module_test.c)

# Include Asset Tracker v2 application folders
target_include_directories(app PRIVATE .)
target_include_directories(app PRIVATE ${ASSET_TRACKER_V2_DIR}/src/)
target_include_directories(app PRIVATE ${ASSET_TRACKER_V2_DIR}/src/watchdog)
target_include_directories(app PRIVATE ${ASSET_TRACKER_V2_DIR}/src/modules/)
target_include_directories(app PRIVATE ${ASSET_TRACKER_V2_DIR}/src/events/)
target_include_directories(app PRIVATE ${ASSET_TRACKER_V2_DIR}/configuration/memfault/)

# Include nRF SDK directories
target_include_directories(app PRIVATE ${NRF_SDK_DIR}/subsys/event_manager)
target_include_directories(app PRIVATE ${NRF_SDK_DIR}/modules/cjson/include)

# Include Memfault SDK directories
target_include_directories(app PRIVATE ${MEMFAULT_SDK_DIR}/components/include/)
target_include_directories(app PRIVATE ${MEMFAULT_SDK_DIR}/components/include/core)

# Include nRFxlib directories
target_include_directories(app PRIVATE ${ZEPHYR_BASE}/../nrfxlib/nrf_modem/include/)

# Options that cannot be passed through Kconfig fragments.
target_compile_options(app PRIVATE
  	-DCONFIG_ASSET_TRACKER_V2_APP_VERSION_MAX_LEN=20
	-DCONFIG_DEBUG_MODULE_LOG_LEVEL=4
	-DCONFIG_MEMFAULT=y
	-DCONFIG_WATCHDOG_APPLICATION=y
	-DCONFIG_DEBUG_MODULE=y
	-DCONFIG_DEBUG_MODULE_MEMFAULT_USE_EXTERNAL_TRANSPORT=y
	-DCONFIG_DEBUG_MODULE_MEMFAULT_WATCHDOG_DELTA_MS=5000
	-DCONFIG_DEBUG_MODULE_MEMFAULT_CHUNK_SIZE_MAX=80
	-DCONFIG_DEBUG_MODULE_MEMFAULT_THREAD_STACK_SIZE=256
)
```

## Kconfig
```
#
# Copyright (c) 2021 Nordic Semiconductor ASA
#
# SPDX-License-Identifier: LicenseRef-Nordic-5-Clause
#

source "Kconfig.zephyr"
```

## prj.conf
```kconfig
#
# Copyright (c) 2021 Nordic Semiconductor ASA
#
# SPDX-License-Identifier: LicenseRef-Nordic-5-Clause
#

CONFIG_UNITY=y
CONFIG_HEAP_MEM_POOL_SIZE=1024

# Make CONFIG_EVENT_MANAGER_MAX_EVENT_CNT defined
CONFIG_EVENT_MANAGER=y

# Event manager requires sys_reboot()
CONFIG_REBOOT=y
# The following option is required to silence the linker warning about orphan
# sections. The event manager header files uses orphan sections.
CONFIG_LINKER_ORPHAN_SECTION_PLACE=y
CONFIG_EVENT_MANAGER_EVENT_LOG_BUF_LEN=0
```

## boards/native_posix.conf
```kconfig
# The following option is required to silence the linker warning about orphan
# sections. The event manager header files uses orphan sections.
CONFIG_LINKER_ORPHAN_SECTION_PLACE=y
CONFIG_EVENT_MANAGER_EVENT_LOG_BUF_LEN=0
```

## src/debug_module_test.c
```c
/*
 * Copyright (c) 2021 Nordic Semiconductor ASA
 *
 * SPDX-License-Identifier: LicenseRef-Nordic-5-Clause
 */

#include <unity.h>
#include <stdbool.h>
#include <stdlib.h>
#include <mock_modules_common.h>
#include <mock_event_manager.h>
#include <mock_event_manager_priv.h>
#include <mock_watchdog_app.h>
#include <memfault/metrics/mock_metrics.h>
#include <memfault/core/mock_data_packetizer.h>
#include <memfault/ports/mock_watchdog.h>

#include "app_module_event.h"
#include "gnss_module_event.h"
#include "debug_module_event.h"
#include "data_module_event.h"

extern struct event_listener __event_listener_debug_module;

/* The addresses of the following structures will be returned when the event_manager_alloc()
 * function is called.
 */
static struct app_module_event app_module_event_memory;
static struct data_module_event data_module_event_memory;
static struct gnss_module_event gnss_module_event_memory;
static struct debug_module_event debug_module_event_memory;

#define DEBUG_MODULE_EVT_HANDLER(eh) __event_listener_debug_module.notification(eh)

/* Copy of the application specific Memfault metrics defined in
 * configuration/memfault/memfault_metrics_heartbeat_config.def
 */
const char * const g_memfault_metrics_id_GnssTimeToFix;
const char * const g_memfault_metrics_id_GnssSatellitesTracked;
const char * const g_memfault_metrics_id_GnssTimeoutSearchTime;

/* Dummy structs to please linker. The EVENT_SUBSCRIBE macros in debug_module.c
 * depend on these to exist. But since we are unit testing, we dont need
 * these subscriptions and hence these structs can remain uninitialized.
 */
struct event_type __event_type_gnss_module_event;
struct event_type __event_type_debug_module_event;
struct event_type __event_type_app_module_event;
struct event_type __event_type_data_module_event;
struct event_type __event_type_cloud_module_event;
struct event_type __event_type_modem_module_event;
struct event_type __event_type_sensor_module_event;
struct event_type __event_type_ui_module_event;
struct event_type __event_type_util_module_event;

/* The following is required because unity is using a different main signature
 * (returns int) and zephyr expects main to not return value.
 */
extern int unity_main(void);

/* Local reference of the internal application watchdog callback in debug module. Used to
 * infuse callback events directly from the test runner.
 */
watchdog_evt_handler_t debug_module_watchdog_callback;

/* Suite teardown finalizes with mandatory call to generic_suiteTearDown. */
extern int generic_suiteTearDown(int num_failures);

int test_suiteTearDown(int num_failures)
{
	return generic_suiteTearDown(num_failures);
}

void setUp(void)
{
	mock_watchdog_app_Init();
	mock_modules_common_Init();
	mock_event_manager_Init();
}

void tearDown(void)
{
	mock_watchdog_app_Verify();
	mock_modules_common_Verify();
	mock_event_manager_Verify();
}

static void latch_watchdog_callback(watchdog_evt_handler_t handler, int no_of_calls)
{
	debug_module_watchdog_callback = handler;
}

static void validate_debug_data_ready_evt(struct event_header *eh, int no_of_calls)
{
	struct debug_module_event *event = cast_debug_module_event(eh);

	TEST_ASSERT_EQUAL(DEBUG_EVT_MEMFAULT_DATA_READY, event->type);
}

void setup_debug_module_in_init_state(void)
{
	__wrap_event_manager_alloc_ExpectAnyArgsAndReturn(&app_module_event_memory);
	__wrap_event_manager_free_ExpectAnyArgs();
	struct app_module_event *app_module_event = new_app_module_event();

	app_module_event->type = APP_EVT_START;

	static struct module_data expected_module_data = {
		.name = "debug",
		.msg_q = NULL,
		.supports_shutdown = false,
	};

	__wrap_watchdog_register_handler_ExpectAnyArgs();
	__wrap_watchdog_register_handler_AddCallback(&latch_watchdog_callback);
	__wrap_module_start_ExpectAndReturn(&expected_module_data, 0);

	TEST_ASSERT_EQUAL(0, DEBUG_MODULE_EVT_HANDLER((struct event_header *)app_module_event));
	event_manager_free(app_module_event);
}

/* Test whether the correct Memfault metrics are set upon a GNSS fix. */
void test_memfault_trigger_metric_sampling_on_gnss_fix(void)
{
	setup_debug_module_in_init_state();

	__wrap_memfault_metrics_heartbeat_set_unsigned_ExpectAndReturn(
						MEMFAULT_METRICS_KEY(GnssTimeToFix),
						60000,
						0);
	__wrap_memfault_metrics_heartbeat_set_unsigned_ExpectAndReturn(
						MEMFAULT_METRICS_KEY(GnssSatellitesTracked),
						4,
						0);
	__wrap_memfault_metrics_heartbeat_debug_trigger_Expect();

	__wrap_event_manager_alloc_ExpectAnyArgsAndReturn(&gnss_module_event_memory);
	__wrap_event_manager_free_ExpectAnyArgs();
	struct gnss_module_event *gnss_module_event = new_gnss_module_event();

	gnss_module_event->type = GNSS_EVT_DATA_READY;
	gnss_module_event->data.gnss.satellites_tracked = 4;
	gnss_module_event->data.gnss.search_time = 60000;

	TEST_ASSERT_EQUAL(0, DEBUG_MODULE_EVT_HANDLER((struct event_header *)gnss_module_event));
	event_manager_free(gnss_module_event);
}

/* Test whether the correct Memfault metrics are set upon a GNSS timeout. */
void test_memfault_trigger_metric_sampling_on_gnss_timeout(void)
{
	resetTest();
	setup_debug_module_in_init_state();

	/* Update this function to expect the search time and number of satellites. */
	__wrap_memfault_metrics_heartbeat_set_unsigned_ExpectAndReturn(
						MEMFAULT_METRICS_KEY(GnssTimeoutSearchTime),
						30000,
						0);
	__wrap_memfault_metrics_heartbeat_set_unsigned_ExpectAndReturn(
						MEMFAULT_METRICS_KEY(GnssSatellitesTracked),
						2,
						0);
	__wrap_memfault_metrics_heartbeat_debug_trigger_Ignore();

	__wrap_event_manager_alloc_ExpectAnyArgsAndReturn(&gnss_module_event_memory);
	__wrap_event_manager_free_ExpectAnyArgs();
	struct gnss_module_event *gnss_module_event = new_gnss_module_event();

	gnss_module_event->type = GNSS_EVT_TIMEOUT;
	gnss_module_event->data.gnss.satellites_tracked = 2;
	gnss_module_event->data.gnss.search_time = 30000;

	TEST_ASSERT_EQUAL(0, DEBUG_MODULE_EVT_HANDLER((struct event_header *)gnss_module_event));
	event_manager_free(gnss_module_event);
}

/* Test that the debug module is able to submit Memfault data externally through events
 * of type DEBUG_EVT_MEMFAULT_DATA_READY carrying chunks of data.
 */
void test_memfault_trigger_data_send(void)
{
	resetTest();
	setup_debug_module_in_init_state();

	__wrap__event_submit_ExpectAnyArgs();

	__wrap_memfault_packetizer_data_available_ExpectAndReturn(1);
	__wrap_memfault_packetizer_get_chunk_ExpectAnyArgsAndReturn(1);
	__wrap_memfault_packetizer_get_chunk_ExpectAnyArgsAndReturn(0);

	/* Expect the debug module to generate an event with accompanied Memfault metric data. */
	__wrap__event_submit_Stub(&validate_debug_data_ready_evt);

	__wrap_event_manager_alloc_ExpectAnyArgsAndReturn(&data_module_event_memory);
	__wrap_event_manager_free_ExpectAnyArgs();
	struct data_module_event *data_module_event = new_data_module_event();

	data_module_event->type = DATA_EVT_DATA_SEND;

	__wrap_event_manager_alloc_IgnoreAndReturn(&debug_module_event_memory);
	TEST_ASSERT_EQUAL(0, DEBUG_MODULE_EVT_HANDLER((struct event_header *)data_module_event));
	event_manager_free(data_module_event);
}

/* Test that no Memfault SDK specific APIs are called on GNSS module events
 * that should not be handled.
 */
void test_memfault_unhandled_event(void)
{
	resetTest();
	setup_debug_module_in_init_state();

	/* Expect no memfault APIs to be called on GNSS_EVT_ACTIVE */

	__wrap_event_manager_alloc_ExpectAnyArgsAndReturn(&gnss_module_event_memory);
	__wrap_event_manager_free_ExpectAnyArgs();
	struct gnss_module_event *gnss_module_event = new_gnss_module_event();

	gnss_module_event->type = GNSS_EVT_ACTIVE;
	TEST_ASSERT_EQUAL(0, DEBUG_MODULE_EVT_HANDLER((struct event_header *)gnss_module_event));

	gnss_module_event->type = GNSS_EVT_INACTIVE;
	TEST_ASSERT_EQUAL(0, DEBUG_MODULE_EVT_HANDLER((struct event_header *)gnss_module_event));

	gnss_module_event->type = GNSS_EVT_SHUTDOWN_READY;
	TEST_ASSERT_EQUAL(0, DEBUG_MODULE_EVT_HANDLER((struct event_header *)gnss_module_event));

	gnss_module_event->type = GNSS_EVT_AGPS_NEEDED;
	TEST_ASSERT_EQUAL(0, DEBUG_MODULE_EVT_HANDLER((struct event_header *)gnss_module_event));

	gnss_module_event->type = GNSS_EVT_ERROR_CODE;
	TEST_ASSERT_EQUAL(0, DEBUG_MODULE_EVT_HANDLER((struct event_header *)gnss_module_event));
	event_manager_free(gnss_module_event);
}

/* Test whether the correct Memfault software watchdog APIs are called on callbacks from the
 * application watchdog library.
 */
void test_memfault_software_watchdog_trigger_on_callback(void)
{
	resetTest();
	setup_debug_module_in_init_state();

	__wrap_memfault_software_watchdog_enable_ExpectAndReturn(0);

	/* Expect a software watchdog timer 5 seconds lower than the passed in value to be used. */
	__wrap_memfault_software_watchdog_update_timeout_ExpectAndReturn(55000, 0);
	__wrap_memfault_software_watchdog_feed_ExpectAndReturn(0);

	struct watchdog_evt evt = {
		.type = WATCHDOG_EVT_START
	};

	debug_module_watchdog_callback(&evt);

	memset(&evt, 0, sizeof(struct watchdog_evt));

	evt.type = WATCHDOG_EVT_TIMEOUT_INSTALLED;
	evt.timeout = 60000;

	debug_module_watchdog_callback(&evt);

	memset(&evt, 0, sizeof(struct watchdog_evt));

	evt.type = WATCHDOG_EVT_FEED;
}

void main(void)
{
	(void)unity_main();
}
```
