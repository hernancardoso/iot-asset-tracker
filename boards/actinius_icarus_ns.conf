## boards/actinius_icarus_ns.conf
```kconfig
#
# Copyright (c) 2021 Nordic Semiconductor ASA
#
# SPDX-License-Identifier: LicenseRef-Nordic-5-Clause
#

# Configuration file for Actinius Icarus.
# This file is merged with prj.conf in the application folder, and options
# set here will take precedence if they are present in both files.

# Configuration related to external sensors.
CONFIG_SENSOR=y
CONFIG_I2C=y

# LIS2DH - Accelerometer
CONFIG_LIS2DH=y
CONFIG_LIS2DH_TRIGGER_GLOBAL_THREAD=y
CONFIG_LIS2DH_ACCEL_RANGE_8G=y
CONFIG_LIS2DH_OPER_MODE_NORMAL=y
CONFIG_LIS2DH_ODR_2=y
```
